## drivers/net/rekernel/Kconfig
```kconfig
menu "Re:Kernel"

config REKERNEL
	tristate "Re:Kernel support"
	default y
	help
	  Make tombstone users get a better experience.

config REKERNEL_DEBUG
	bool "Re:Kernel debug mode"
	depends on REKERNEL
	default n
	help
	  Enable Re:Kernel debug logging output.

endmenu
```
